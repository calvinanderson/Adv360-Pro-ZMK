macro_expose: macro_expose{
compatible = "zmk,behavior-macro";
label = "macro_expose";
#binding-cells = <0>;
bindings = <&kp LS(F3)>;
};
macro_spotlight: macro_spotlight{
compatible = "zmk,behavior-macro";
label = "macro_spotlight";
#binding-cells = <0>;
bindings = <&kp LG(SPACE)>;
};